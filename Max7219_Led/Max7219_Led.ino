#include <LedControl.h> 

int DIN = 13;
int CS =  15;
int CLK = 14;

byte num[10][8] = {{0x00,0x00,0x1C,0x14,0x14,0x14,0x1C,0x00},
                   {0x00,0x00,0x08,0x08,0x08,0x08,0x08,0x00},
                   {0x00,0x00,0x1C,0x04,0x1C,0x10,0x1C,0x00},
                   {0x00,0x00,0x1C,0x04,0x1C,0x04,0x1C,0x00},
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                   {0x00,0x00,0x1C,0x14,0x1C,0x04,0x1C,0x00}};

byte buff[8] = {0x00, 0x00, 0x00, 0x00, 0x00, 0x00, 0x00, 0x00};

LedControl lc=LedControl(DIN,CLK,CS,0);

void setup(){
 lc.shutdown(0,false);       //The MAX72XX is in power-saving mode on startup
 lc.setIntensity(0,8);      // Set the brightness to maximum value
 lc.clearDisplay(0);         // and clear the display
 Serial.begin(9600);
}

void loop(){ 

    for(int i = 0; i < 10; i++){
      printByte(num[i]);
      delay(1000);
    }
    //lc.clearDisplay(0);
    
    //delay(1000);
}

void printByte(byte character [])
{
  int i = 0;
  for(int j = 7; j >= 0; j--){
    scroll(character[j]);
    for(i=0;i<8;i++)
    {
      lc.setRow(0,i,buff[i]);
    }
    delay(50);
  }
}

void scroll(byte charbuf){
  for(int i = 0; i < 7; i++){
    buff[7-i] = buff[7-i-1];
  }
  buff[0] = charbuf;
}
